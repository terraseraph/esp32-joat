## main/Kconfig.projbuild
```kconfig
menu "Managed device runtime"

    config RUNTIME_BOOT_RECOVERY_MS
        int "BOOT hold ms to enable recovery AP"
        default 5000

    config RUNTIME_BOOT_PROVISION_MS
        int "BOOT hold ms to clear Wi-Fi and provision"
        default 10000

    config RUNTIME_BOOT_FACTORY_MS
        int "BOOT hold ms to factory-reset user config"
        default 20000

    config RUNTIME_CRASH_LOOP_THRESHOLD
        int "Consecutive crash boots before safe mode"
        default 5

    config RUNTIME_WIFI_FAIL_AP_MS
        int "ms without STA IP before recovery SoftAP"
        default 60000

    config RUNTIME_HEALTHY_CLEAR_MS
        int "ms of healthy runtime before clearing crash counter"
        default 30000

endmenu
```

## sdkconfig.defaults
```kconfig
# Shared defaults. Target-specific overrides live in sdkconfig.defaults.esp32.
# Pin ESP-IDF 5.4.x. Do not enable Arduino. Bluetooth is omitted from the build (not just disabled).

CONFIG_PARTITION_TABLE_CUSTOM=y
CONFIG_PARTITION_TABLE_CUSTOM_FILENAME="partitions.csv"
CONFIG_PARTITION_TABLE_OFFSET=0x8000

CONFIG_COMPILER_CXX_EXCEPTIONS=n
CONFIG_COMPILER_CXX_RTTI=n
CONFIG_COMPILER_OPTIMIZATION_SIZE=y
CONFIG_NEWLIB_NANO_FORMAT=y

CONFIG_HTTPD_WS_SUPPORT=y
CONFIG_HTTPD_MAX_REQ_HDR_LEN=1024
CONFIG_HTTPD_MAX_URI_LEN=512

CONFIG_LWIP_DHCPS=y
CONFIG_LWIP_MAX_SOCKETS=20
CONFIG_LWIP_IPV6=n

CONFIG_ESP_MAIN_TASK_STACK_SIZE=8192
CONFIG_ESP_SYSTEM_EVENT_TASK_STACK_SIZE=4096
CONFIG_ESP_TIMER_TASK_STACK_SIZE=4096

CONFIG_BOOTLOADER_APP_ROLLBACK_ENABLE=y
CONFIG_APP_ROLLBACK_ENABLE=y
CONFIG_ESP_TASK_WDT_TIMEOUT_S=15
CONFIG_ESP_INT_WDT=y
CONFIG_ESP_INT_WDT_TIMEOUT_MS=300

CONFIG_MQTT_TRANSPORT_WEBSOCKET=n
CONFIG_MQTT_PROTOCOL_311=y

CONFIG_LOG_DEFAULT_LEVEL_INFO=y
CONFIG_LOG_MAXIMUM_EQUALS_DEFAULT=n
CONFIG_LOG_MAXIMUM_LEVEL_DEBUG=y

CONFIG_ESP_CONSOLE_UART_DEFAULT=y
CONFIG_ESP_CONSOLE_UART_BAUDRATE=115200

CONFIG_FREERTOS_HZ=1000
CONFIG_FREERTOS_TIMER_TASK_STACK_DEPTH=4096
CONFIG_FREERTOS_USE_TRACE_FACILITY=y
```
